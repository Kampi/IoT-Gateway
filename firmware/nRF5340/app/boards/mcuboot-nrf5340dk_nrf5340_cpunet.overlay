/ {
	mcuboot_recovery_buttons: mcuboot_recovery_buttons {
		compatible = "gpio-keys";

		mcuboot_recovery0: mcuboot_recovery_0 {
			gpios = <&gpio1 15 (GPIO_PULL_UP | GPIO_ACTIVE_LOW)>;
			label = "MCUboot recovery";
		};
	};

	aliases {
		mcuboot-button0 = &mcuboot_recovery0;
	};
};
