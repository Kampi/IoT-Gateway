## os/layers/meta-iot-gateway-os/conf/machine/verdin-imx8mm-extra.conf
```bitbake
# SPDX-License-Identifier: MIT
# Copyright (c) 2026 Daniel Kampert

KERNEL_DEVICETREE:append = " freescale/iot-gateway-imx8mm.dtb"
```
